## Firmware/boards/lifegps/lifegps/board.yml
```yaml
# SPDX-License-Identifier: MIT
board:
  name: lifegps
  full_name: Life_GPS Main V0.2 (nRF54L15-QFAA)
  vendor: lifegps
  socs:
    - name: nrf54l15
```

## Firmware/boards/lifegps/lifegps/lifegps_nrf54l15_cpuapp_defconfig
```kconfig
# Copyright (c) 2026 Life_GPS contributors
# SPDX-License-Identifier: MIT

CONFIG_GPIO=y
CONFIG_ARM_MPU=y
```

## Firmware/tests/lifegps.activity/testcase.yaml
```yaml
# SPDX-License-Identifier: MIT
tests:
  lifegps.activity:
    platform_allow: native_sim
    integration_platforms:
      - native_sim
    tags: lifegps
```

## Firmware/tests/lifegps.archive/testcase.yaml
```yaml
# SPDX-License-Identifier: MIT
tests:
  lifegps.archive:
    platform_allow: native_sim
    integration_platforms:
      - native_sim
    tags: lifegps
```

## Firmware/tests/lifegps.battery_soc/testcase.yaml
```yaml
# SPDX-License-Identifier: MIT
tests:
  lifegps.battery_soc:
    platform_allow: native_sim
    integration_platforms:
      - native_sim
    tags: lifegps
```

## Firmware/tests/lifegps.ble_frame/testcase.yaml
```yaml
# SPDX-License-Identifier: MIT
tests:
  lifegps.ble_frame:
    platform_allow: native_sim
    integration_platforms:
      - native_sim
    tags: lifegps
```

## Firmware/tests/lifegps.bmp388/testcase.yaml
```yaml
# SPDX-License-Identifier: MIT
tests:
  lifegps.bmp388:
    platform_allow: native_sim
    integration_platforms:
      - native_sim
    tags: lifegps
```

## Firmware/tests/lifegps.calib/testcase.yaml
```yaml
# SPDX-License-Identifier: MIT
tests:
  lifegps.calib:
    platform_allow: native_sim
    integration_platforms:
      - native_sim
    tags: lifegps
```

## Firmware/tests/lifegps.config/testcase.yaml
```yaml
# SPDX-License-Identifier: MIT
tests:
  lifegps.config:
    platform_allow: native_sim
    integration_platforms:
      - native_sim
    tags: lifegps
```

## Firmware/tests/lifegps.floor/testcase.yaml
```yaml
# SPDX-License-Identifier: MIT
tests:
  lifegps.floor:
    platform_allow: native_sim
    integration_platforms:
      - native_sim
    tags: lifegps
```

## Firmware/tests/lifegps.gnss_fsm/testcase.yaml
```yaml
# SPDX-License-Identifier: MIT
tests:
  lifegps.gnss_fsm:
    platform_allow: native_sim
    integration_platforms:
      - native_sim
    tags: lifegps
```

## Firmware/tests/lifegps.nav/testcase.yaml
```yaml
# SPDX-License-Identifier: MIT
tests:
  lifegps.nav:
    platform_allow: native_sim
    integration_platforms:
      - native_sim
    tags: lifegps
```

## Firmware/tests/lifegps.recorder/testcase.yaml
```yaml
# SPDX-License-Identifier: MIT
tests:
  lifegps.recorder:
    platform_allow: native_sim
    integration_platforms:
      - native_sim
    tags: lifegps
```

## Firmware/tests/lifegps.ring/testcase.yaml
```yaml
# SPDX-License-Identifier: MIT
tests:
  lifegps.ring:
    platform_allow: native_sim
    integration_platforms:
      - native_sim
    tags: lifegps
```

## Firmware/tests/lifegps.sflp/testcase.yaml
```yaml
# SPDX-License-Identifier: MIT
tests:
  lifegps.sflp:
    platform_allow: native_sim
    integration_platforms:
      - native_sim
    tags: lifegps
```

## Firmware/tests/lifegps.traj/testcase.yaml
```yaml
tests:
  lifegps.traj:
    platform_allow: native_sim
    integration_platforms:
      - native_sim
    tags: lifegps
```

## Firmware/tests/lifegps.ubx/testcase.yaml
```yaml
# SPDX-License-Identifier: MIT
tests:
  lifegps.ubx:
    platform_allow: native_sim
    integration_platforms:
      - native_sim
    tags: lifegps
```
